#include <Wire.h>
#include <Adafruit_GFX.h>
#include <Adafruit_SSD1306.h>
#include <OneWire.h>
#include <DallasTemperature.h>
//#include <Fonts/FreeSans9pt7b.h>

// 'BootFrame1', 128x64px
const unsigned char BootFramesBootFrame1 [] PROGMEM = {
	0x00, 0x00, 0x00, 0x00, 0x00, 0x00, 0x00, 0x00, 0x00, 0x00, 0x00, 0x00, 0x00, 0x00, 0x00, 0x00, 
	0x00, 0x00, 0x00, 0x00, 0x00, 0x00, 0x00, 0x00, 0x00, 0x00, 0x00, 0x00, 0x00, 0x00, 0x00, 0x00, 
	0x00, 0x00, 0x00, 0x00, 0x00, 0x00, 0x00, 0x00, 0x00, 0x00, 0x00, 0x00, 0x00, 0x00, 0x00, 0x00, 
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	0x00, 0x00, 0x00, 0x00, 0x00, 0x00, 0x00, 0x00, 0x00, 0x00, 0x00, 0x00, 0x00, 0x00, 0x00, 0x00
};
// 'BootFrame2', 128x64px
const unsigned char BootFramesBootFrame2 [] PROGMEM = {
	0x00, 0x00, 0x00, 0x00, 0x00, 0x00, 0x00, 0x00, 0x00, 0x00, 0x00, 0x00, 0x00, 0x00, 0x00, 0x00, 
	0x00, 0x00, 0x00, 0x00, 0x00, 0x00, 0x00, 0x00, 0x00, 0x00, 0x00, 0x00, 0x00, 0x00, 0x00, 0x00, 
	0x00, 0x00, 0x00, 0x00, 0x00, 0x00, 0x00, 0x00, 0x00, 0x00, 0x00, 0x00, 0x00, 0x00, 0x00, 0x00, 
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	0x00, 0x00, 0x00, 0x00, 0x00, 0x00, 0x00, 0x00, 0x00, 0x00, 0x00, 0x00, 0x00, 0x00, 0x00, 0x00
};
// 'BootFrame3', 128x64px
const unsigned char BootFramesBootFrame3 [] PROGMEM = {
	0x00, 0x00, 0x00, 0x00, 0x00, 0x00, 0x00, 0x00, 0x00, 0x00, 0x00, 0x00, 0x00, 0x00, 0x00, 0x00, 
	0x00, 0x00, 0x00, 0x00, 0x00, 0x00, 0x00, 0x00, 0x00, 0x00, 0x00, 0x00, 0x00, 0x00, 0x00, 0x00, 
	0x00, 0x00, 0x00, 0x00, 0x00, 0x00, 0x00, 0x00, 0x00, 0x00, 0x00, 0x00, 0x00, 0x00, 0x00, 0x00, 
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	0x00, 0x00, 0x00, 0x00, 0x00, 0x00, 0x00, 0x00, 0x00, 0x00, 0x00, 0x00, 0x00, 0x00, 0x00, 0x00
};
// 'BootFrame4', 128x64px
const unsigned char BootFramesBootFrame4 [] PROGMEM = {
	0x00, 0x00, 0x00, 0x00, 0x00, 0x00, 0x00, 0x00, 0x00, 0x00, 0x00, 0x00, 0x00, 0x00, 0x00, 0x00, 
	0x00, 0x00, 0x00, 0x00, 0x00, 0x00, 0x00, 0x00, 0x00, 0x00, 0x00, 0x00, 0x00, 0x00, 0x00, 0x00, 
	0x00, 0x00, 0x00, 0x00, 0x00, 0x00, 0x00, 0x00, 0x00, 0x00, 0x00, 0x00, 0x00, 0x00, 0x00, 0x00, 
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	0x00, 0x00, 0x00, 0x00, 0x00, 0x00, 0x00, 0x00, 0x00, 0x00, 0x00, 0x00, 0x00, 0x00, 0x00, 0x00
};

// Array of all bitmaps for convenience. (Total bytes used to store images in PROGMEM = 4160)
const int BootFramesallArray_LEN = 4;
const unsigned char* BootFramesallArray[4] = {
	BootFramesBootFrame1,
	BootFramesBootFrame2,
	BootFramesBootFrame3,
	BootFramesBootFrame4
};

// OLED setup
#define SCREEN_WIDTH 128
#define SCREEN_HEIGHT 64
Adafruit_SSD1306 display(SCREEN_WIDTH, SCREEN_HEIGHT, &Wire, -1);

// Sensor (DS18B20) pin
#define ONE_WIRE_BUS 2
OneWire oneWire(ONE_WIRE_BUS);
DallasTemperature sensors(&oneWire);

// Heater setup
const int HEAT_GATE = 5; // MOSFET PWM-capable Heat Gate pin

// Heater control parameters
bool safetyShutdown = false;
const float TEMP_SETPOINT = 37.0;
const float TEMP_50_START = 34;
const float TEMP_20_START = 35;
const float TEMP_OFF_AT   = 37.0;

// Temperature regulation variables
float previousTemp = NAN;
unsigned long lastStoreTime = 0;
const unsigned long storeInterval = 30000;   // 30 seconds

// PWM values
const int PWM_OFF  = 0;
const int PWM_20   = 51;    // about 20% of 255, so around 20% heater power
const int PWM_50   = 128;   // about 50% heater power
const int PWM_100  = 255;   // 100% heater power

int heaterPWM = 0;

//const int VENT_GATE = 4; not currently using a vent

//bool ventOn = false;

void showBootAnimation() {
  for (int cycle = 0; cycle < 3; cycle++) {
    display.clearDisplay();
    display.drawBitmap(0, 0, BootFramesBootFrame1, 128, 64, SSD1306_WHITE);
    display.display();
    delay(250);

    display.clearDisplay();
    display.drawBitmap(0, 0, BootFramesBootFrame2, 128, 64, SSD1306_WHITE);
    display.display();
    delay(250);

    display.clearDisplay();
    display.drawBitmap(0, 0, BootFramesBootFrame3, 128, 64, SSD1306_WHITE);
    display.display();
    delay(250);

    display.clearDisplay();
    display.drawBitmap(0, 0, BootFramesBootFrame4, 128, 64, SSD1306_WHITE);
    display.display();
    delay(250);
  }
}

void setup() {
  Serial.begin(9600);

  // Initialize OLED
  if (!display.begin(SSD1306_SWITCHCAPVCC, 0x3C)) {
    Serial.println(F("SSD1306 allocation failed"));
    for (;;);
  }
  display.clearDisplay();
  //display.setFont(&FreeSans9pt7b);
  display.setTextSize(1);
  display.setTextColor(SSD1306_WHITE);
  display.cp437(true);

	showBootAnimation();


  // DS18B20 setup
  sensors.begin();
	

  // MOSFET Heat gate setup
  pinMode(HEAT_GATE, OUTPUT);
  analogWrite(HEAT_GATE, PWM_OFF);
  heaterPWM = PWM_OFF;

  // MOSFET Vent gate setup
  //pinMode(VENT_GATE, OUTPUT);
  //digitalWrite(VENT_GATE, LOW);
  //ventOn = false;

  // OLED ready message
  display.clearDisplay();
  //display.setCursor(0, 0);
  //display.print(F("System ready"));
  display.display();

  Serial.println(F("System ready: DS18B20 + OLED"));
}

void setHeaterPWM(int pwmValue) {
  pwmValue = constrain(pwmValue, 0, 255);
  heaterPWM = pwmValue;
  analogWrite(HEAT_GATE, heaterPWM);
}

//void setVent(bool on) {
//  ventOn = on;
//  digitalWrite(VENT_GATE, on ? HIGH : LOW);
//}

void drawCentreString(const char *buf, int y) {
  int16_t x1, y1;
  uint16_t w, h;
  // Calculate text bounds
  display.getTextBounds(buf, 0, y, &x1, &y1, &w, &h);
  // Center horizontally based on display width (e.g., 128)
  display.setCursor((display.width() - w) / 2, y);
  display.print(buf);

}

void loop() {
	
	unsigned long now = millis();

// Read temperature
  sensors.requestTemperatures();
  float currentTemp = sensors.getTempCByIndex(0);

// Storing past temperatures
	//Serial.print("now: "); Serial.print(now);
	//Serial.print(" lastStoreTime: "); Serial.print(lastStoreTime);
	//Serial.print(" elapsed: "); Serial.println(now - lastStoreTime);
	if (!safetyShutdown && now - lastStoreTime >= storeInterval) {
			Serial.println("=== Protection check running ===");
			//Serial.print(" cond1: "); Serial.print(currentTemp < previousTemp + 1);
			//Serial.print(" cond2: "); Serial.println(currentTemp <= TEMP_50_START);
			if (!safetyShutdown && currentTemp < previousTemp + 0.2 && currentTemp <= TEMP_OFF_AT - 1) {  // Overheating safety feature
				setHeaterPWM(PWM_OFF);
				safetyShutdown = true;
				Serial.print("Overheating protection activated");
			 } 				
			lastStoreTime = now;
			previousTemp = currentTemp; // Store the latest measured value
	}

// Heater control with stepped PWM
	if (safetyShutdown) {
			setHeaterPWM(PWM_OFF); // Heater off if overheating protection was activated
	} else {
			if (currentTemp == DEVICE_DISCONNECTED_C) {
			setHeaterPWM(PWM_OFF);
		} else {
			if (currentTemp < TEMP_50_START) {
				setHeaterPWM(PWM_100);
			} else if (currentTemp < TEMP_20_START) {
				setHeaterPWM(PWM_50);
			} else if (currentTemp < TEMP_OFF_AT) {
				setHeaterPWM(PWM_20);
			} else {
				setHeaterPWM(PWM_OFF);
			}
		}
	}
  
// Vent gate control
  //if (!ventOn && currentTemp >= OFF_ABOVE + 0.5) {
  //  setVent(true);
  //} else if (ventOn && currentTemp <= ON_BELOW + 0.5) {
  //  setVent(false);
  //}

// Serial output on terminal
  //Serial.print(F("Temperature: "));
  //if (currentTemp == DEVICE_DISCONNECTED_C) {
    //Serial.println(F("ERR"));
  //} else {
    //Serial.print(currentTemp, 1);
    //Serial.write((uint8_t)248); // degree symbol for many Windows terminals
    //Serial.println(F("C"));
  //}

  //Serial.print(F(" | Heater PWM: "));
  //Serial.print(heaterPWM);

  Serial.print(F(" | Power: "));
  if (heaterPWM == PWM_OFF) {
    Serial.println(F("OFF"));
  } else if (heaterPWM == PWM_20) {
    Serial.println(F("20%"));
  } else if (heaterPWM == PWM_50) {
    Serial.println(F("50%"));
  } else {
    Serial.println(F("100%"));
  }

  display.clearDisplay();

  char tempLine[24];
  char tempStr[10];
	char overrideLine[30];
  char heaterLine[20];
  char setTempStr[10];
  char setTempLine[25];

if (safetyShutdown) {
			snprintf(setTempLine, sizeof(setTempLine), "OVERRIDE ON");
			drawCentreString(setTempLine, 10);
			snprintf(tempLine, sizeof(tempLine), "check sensor");
			drawCentreString(tempLine, 30);
			snprintf(heaterLine, sizeof(heaterLine), "restart device");
			drawCentreString(heaterLine, 50);
	} else if (currentTemp == DEVICE_DISCONNECTED_C || currentTemp == -127) {
			strcpy(tempLine, "Temperature: ERROR");
	}	else {
			dtostrf(TEMP_SETPOINT, 0, 1, setTempStr);
			snprintf(setTempLine, sizeof(setTempLine), "Set to: %s%cC", setTempStr, 248);   //OLED target temp set
			dtostrf(currentTemp, 0, 1, tempStr);                                            //OLED current temp status
			snprintf(tempLine, sizeof(tempLine), "Temperature: %s%cC", tempStr, 248); 
			snprintf(heaterLine, sizeof(heaterLine), "Heater: %s",                          //OLED Heater Power status 
				(heaterPWM == PWM_OFF) ? "OFF" :
				(heaterPWM == PWM_20)  ? "20%" :
				(heaterPWM == PWM_50)  ? "50%" : "100%");
	}
	drawCentreString(setTempLine, 10);
	drawCentreString(tempLine, 30);
	drawCentreString(heaterLine, 50);
	display.display();
	delay(1000);
}

